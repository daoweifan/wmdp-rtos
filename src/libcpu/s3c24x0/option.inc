;===========================================
; NAME: OPTION.A
; DESC: Configuration options for .S files
; HISTORY:
; 02.28.2002: ver 0.0
; 03.11.2003: ver 0.0	attached for 2440.
; jan E, 2004: ver0.03  modified for 2440A01.
; David, 2011: ver1.0	modified for IAR IDE4.42
; david: 2013: ver 0.0	Attatched for IAR IDE6.1
;===========================================

;Start address of each stacks,
; _STACK_BASEADDRESS	EQU 0x33ff8000
; _MMUTT_STARTADDRESS	EQU 0x33ff8000
_ISR_STARTADDRESS	EQU 0x33ffff00

;		GBLL 	PLL_ON_START
;PLL_ON_START	SETL	{TRUE}
PLL_ON_START	SETA	1

;		GBLL	ENDIAN_CHANGE
;ENDIAN_CHANGE	SETL	{FALSE}
ENDIAN_CHANGE	SETA	0

;		GBLA	ENTRY_BUS_WIDTH
ENTRY_BUS_WIDTH	SETA	16


;BUSWIDTH = 16,32
;		GBLA    BUSWIDTH	;max. bus width for the GPIO configuration
BUSWIDTH	SETA    32

;		GBLA	UCLK
UCLK	SETA	96000000;48000000

;		GBLA	XTAL_SEL
;		GBLA	FCLK
;		GBLA	CPU_SEL

;(1) Select CPU
;CPU_SEL	SETA	32440000	; 32440000:2440X.
CPU_SEL		SETA	32440001	; 32440001:2440A

;(2) Select XTaL
XTAL_SEL	SETA	12000000	;hzh
;XTAL_SEL	SETA	16934400

;(3) Select FCLK
;FCLK		SETA	100000000	;hzh
;FCLK		SETA	240000000	;hzh
;FCLK		SETA	320000000	;hzh
;FCLK		SETA	360000000	;hzh
FCLK		SETA	400000000	;hzh

;(4) Select Clock Division (Fclk:Hclk:Pclk)
;CLKDIV_VAL	EQU	5	; 0=1:1:1, 1=1:1:2, 2=1:2:2, 3=1:2:4, 4=1:4:4, 5=1:4:8, 6=1:3:3, 7=1:3:6.

	IF XTAL_SEL = 12000000

	IF FCLK = 100000000
CLKDIV_VAL	EQU	0		;1:1:1
M_MDIV		EQU	42		;Fin=12.0MHz Fout=100MHz
M_PDIV		EQU	4
		IF CPU_SEL = 32440001
M_SDIV		EQU	1		; 2440A
		ELSE
M_SDIV		EQU	0		; 2440X
		ENDIF
	ENDIF

	IF FCLK = 240000000
CLKDIV_VAL	EQU	4		;1:4:4
M_MDIV		EQU	112		;Fin=12.0MHz Fout=240MHz
M_PDIV		EQU	4
		IF CPU_SEL = 32440001
M_SDIV		EQU	1		; 2440A
		ELSE
M_SDIV		EQU	0		; 2440X
		ENDIF
	ENDIF

	IF FCLK = 320000000
CLKDIV_VAL	EQU	5		;1:4:8
M_MDIV		EQU	72		;Fin=12.0MHz Fout=320MHz
M_PDIV		EQU	1
		IF CPU_SEL = 32440001
M_SDIV		EQU	1		; 2440A
		ELSE
M_SDIV		EQU	0		; 2440X
		ENDIF
	ENDIF

	IF FCLK = 360000000
CLKDIV_VAL	EQU	5		;1:4:8
M_MDIV		EQU	82		;Fin=12.0MHz Fout=360MHz
M_PDIV		EQU	1
		IF CPU_SEL = 32440001
M_SDIV		EQU	1		; 2440A
		ELSE
M_SDIV		EQU	0		; 2440X
		ENDIF
	ENDIF

	IF FCLK = 400000000
CLKDIV_VAL	EQU	5		;1:4:8
M_MDIV		EQU	92		;Fin=12.0MHz Fout=400MHz
M_PDIV		EQU	1
		IF CPU_SEL = 32440001
M_SDIV		EQU	1		; 2440A
		ELSE
M_SDIV		EQU	0		; 2440X
		ENDIF
	ENDIF

	IF UCLK = 48000000
U_MDIV		EQU	56		;Fin=12.0MHz Fout=48MHz
U_PDIV		EQU	2
		IF CPU_SEL = 32440001
U_SDIV		EQU	2		; 2440A
   		ELSE
U_SDIV		EQU	1		; 2440X
   		ENDIF
	ENDIF

	IF UCLK = 96000000
U_MDIV		EQU	56		;Fin=12.0MHz Fout=96MHz
U_PDIV		EQU	2
		IF CPU_SEL = 32440001
U_SDIV		EQU	1		; 2440A
		ELSE
U_SDIV		EQU	0		; 2440X
		ENDIF
	ENDIF

	ENDIF ; end of if XTAL_SEL = 12000000.
