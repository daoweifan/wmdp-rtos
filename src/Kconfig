## src/Kconfig
```kconfig
#
# bldc configuration written in linux configuration language
#
# Written by daowei@2013
#

mainmenu_name "wmdp software platform settings"

mainmenu_option next_comment
  comment 'libcpu'
  source src/libcpu/Kconfig
endmenu

mainmenu_option next_comment
  comment 'board'
  source src/board/Kconfig
endmenu

mainmenu_option next_comment
  comment 'drivers'
  source src/drivers/Kconfig
endmenu

mainmenu_option next_comment
  comment 'component'
  source src/component/Kconfig
endmenu

mainmenu_option next_comment
  comment 'freertos'
  source src/freertos/Kconfig
endmenu
```

## src/board/Kconfig
```kconfig
#
# bldc configuration written in linux configuration language
#
# Written by daowei@2013
#
#######################Please ensure the tasks in alphabetical order###############
choice 'board select'	" \
	NONE	CONFIG_BOARD_NONE \
	ETHCAN  CONFIG_BOARD_ETHCAN \
" NONE

if [ "$CONFIG_BOARD_ETHCAN" = "y" ]; then
	mainmenu_option next_comment
		comment 'ethnet-can applications select'
		source src/board/ethcan/Kconfig
	endmenu
fi
```

## src/component/Kconfig
```kconfig
#
# bldc configuration written in linux configuration language
#
# Written by daowei@2013
#
mainmenu_option next_comment
	comment 'finsh shell config'
	source src/component/finsh/Kconfig
endmenu
```

## src/component/finsh/Kconfig
```kconfig
#
# bldc configuration written in linux configuration language
#
# Written by daoweifan@2010
#

bool "enable finsh shell module" CONFIG_COMPONENT_FINSH

if [ "$CONFIG_COMPONENT_FINSH" = "y" ]; then
	choice 'default finsh shell select'	" \
		UARTg	CONFIG_FINSH_UARTg \
		UART0	CONFIG_FINSH_UART0 \
		UART1	CONFIG_FINSH_UART1 \
		UART2	CONFIG_FINSH_UART2 \
	" UART0
fi

bool "using syscall&var table linkfile" CONFIG_FINSH_USING_SYMTAB
bool "using description of syscall&var" CONFIG_FINSH_USING_DESCRIPTION
int "set finsh shell task stack size"   CONFIG_FINSH_TASK_STACK_SIZE 4096
int "set finsh shell task priority"     CONFIG_FINSH_TASK_PRIORITY 1
```

## src/libcpu/Kconfig
```kconfig
#
# bldc configuration written in linux configuration language
#
# Written by daowei@2013
#
#######################Please ensure the tasks in alphabetical order###############

bool "select cpu s3c24x0" CONFIG_CPU_S3C24X0
if [ "$CONFIG_CPU_S3C24X0" = "y"] ; then
	mainmenu_option next_comment
		comment 's3c24x0 config'
		source src/libcpu/s3c24x0/Kconfig
	endmenu
fi
```
